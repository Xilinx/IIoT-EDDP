## HLS/ARTY_Z7_FULL/os/petalinux/project-spec/meta-plnx-generated/conf/machine/plnx_arm.conf
```bitbake
require conf/machine/include/tune-zynq.inc
require conf/machine/include/machine-xilinx-board.inc
require conf/machine/include/machine-xilinx-default.inc

PREFERRED_PROVIDER_virtual/kernel = "linux-xlnx"
PREFERRED_PROVIDER_virtual/bootloader = "u-boot-xlnx"
PREFERRED_PROVIDER_virtual/dtb = "device-tree-generation"
PREFERRED_PROVIDER_virtual/hdf = "external-hdf"
PREFERRED_PROVIDER_virtual/bitstream = "bitstream-extraction"
EXTRA_IMAGEDEPENDS += "device-tree-generation"
PREFERRED_PROVIDER_virtual/fsbl = "fsbl"
EXTRA_IMAGEDEPENDS += "fsbl"
UBOOT_MACHINE = "zynq_zc702_config"
INITRAMFS_IMAGE_BUNDLE = "1"
INITRAMFS_IMAGE = "petalinux-user-image"
IMAGE_FSTYPES_append = " tar.gz cpio cpio.gz"
INITRAMFS_MAXSIZE = "524288"
SERIAL_CONSOLE= "115200 ttyPS0"
MACHINE_EXTRA_RRECOMMENDS += " kernel-modules"
MACHINE_FEATURES = "rtc ext2 ext3 vfat usbhost"
```
